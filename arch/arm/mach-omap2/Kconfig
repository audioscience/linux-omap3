## arch/arm/mach-omap2/Kconfig
```kconfig
comment "OMAP Core Type"
	depends on ARCH_OMAP2

config ARCH_OMAP24XX
	bool "OMAP24xx Based System"
	depends on ARCH_OMAP2

config ARCH_OMAP2420
	bool "OMAP2420 support"
	depends on ARCH_OMAP24XX
	select OMAP_DM_TIMER
	select ARCH_OMAP_OTG
	select CPU_V6

config ARCH_OMAP2430
	bool "OMAP2430 support"
	depends on ARCH_OMAP24XX
	select ARCH_OMAP_OTG
	select CPU_V6

config ARCH_OMAP34XX
	bool "OMAP34xx Based System"
	depends on ARCH_OMAP3

config ARCH_OMAP3430
	bool "OMAP3430 support"
	depends on ARCH_OMAP3 && ARCH_OMAP34XX
	select ARCH_OMAP_OTG
	select CPU_V7

config ARCH_OMAP35XX
	bool "OMAP35x Family"
	select ARCH_OMAP3
	select ARCH_OMAP34XX
	select ARCH_OMAP3430
	select NEON
	help
	  OMAP35x family of processors based on ARM Cortex-A8
	  in combination with IVA2.2 core and OpenGL ES2.0
	  compatible graphics engine.
	    OMAP3503 - Based on ARM Cortex-A8
	    OMAP3515 - OMAP3503 + SGX
	    OMAP3525 - OMAP3503 + IVA2.2
	    OMAP3530 - OMAP3503 + IVA2.2 + SGX

	    OMAP3505 - Based on ARM Cortex-A8
	    OMAP3517 - OMAP3505  + SGX

	  ARM Cortex-A8 contains NEON SIMD coprocessor.

comment "OMAP Board Type"
	depends on ARCH_OMAP2 || ARCH_OMAP3

config MACH_OMAP_GENERIC
	bool "Generic OMAP board"
	depends on ARCH_OMAP2 && ARCH_OMAP24XX

config MACH_NOKIA_N800
	bool "Nokia N800"
	depends on ARCH_OMAP2420
	select VIDEO_TCM825X if VIDEO_OMAP2 && VIDEO_HELPER_CHIPS_AUTO
	select CBUS if VIDEO_TCM825X
	select CBUS_RETU if VIDEO_TCM825X
	select MENELAUS if VIDEO_TCM825X
	select OMAP_GPIO_SWITCH

config MACH_NOKIA_N810
	bool "Nokia N810"
	depends on MACH_NOKIA_N800

config MACH_NOKIA_N810_WIMAX
	bool "Nokia N810 WiMAX"
	depends on MACH_NOKIA_N800
	select MACH_NOKIA_N810

config MACH_NOKIA_RX51
	bool "Nokia RX-51 board"
	depends on ARCH_OMAP3 && ARCH_OMAP34XX

config MACH_OMAP2_TUSB6010
	bool
	depends on ARCH_OMAP2 && ARCH_OMAP2420
	default y if MACH_NOKIA_N800

config MACH_OMAP_H4
	bool "OMAP 2420 H4 board"
	depends on ARCH_OMAP2 && ARCH_OMAP2420
	select OMAP_DEBUG_DEVICES

config MACH_OMAP_H4_TUSB
	bool "TUSB 6010 EVM board"
	depends on MACH_OMAP_H4
	select MACH_OMAP2_TUSB6010
	help
	  Set this if you've got a TUSB6010 high speed USB board.
	  You may need to consult the schematics for your revisions
	  of the Menelaus and TUSB boards, and make changes to be
	  sure this is set up properly for your board stack.

	  Be sure to select OTG mode operation, not host-only or
	  peripheral-only.

config MACH_OMAP_H4_OTG
	bool "Use USB OTG connector, not device connector (S1.10)"
	depends on MACH_OMAP_H4
	help
	  Set this if you've set S1.10 (on the mainboard) to use the
	  Mini-AB (OTG) connector and OTG transceiver with the USB0
	  port, instead of the Mini-B ("download") connector with its
	  non-OTG transceiver.

	  Note that the "download" connector can be used to bootstrap
	  the system from the OMAP mask ROM.  Also, since this is a
	  development platform, you can also force the OTG port into
	  a non-OTG operational mode.

config MACH_OMAP2_H4_USB1
	bool "Use USB1 port, not UART2 (S3.3)"
	depends on MACH_OMAP_H4
	help
	  Set this if you've set SW3.3 (on the CPU card) so that the
	  expansion connectors receive USB1 signals instead of UART2.

config MACH_OMAP_APOLLON
	bool "OMAP 2420 Apollon board"
	depends on ARCH_OMAP2 && ARCH_OMAP2420

config MACH_OMAP_2430SDP
	bool "OMAP 2430 SDP board"
	depends on ARCH_OMAP2 && ARCH_OMAP2430

config MACH_OMAP2EVM
	bool "OMAP 2530 EVM board"
	depends on ARCH_OMAP2 && ARCH_OMAP24XX

config MACH_OMAP_LDP
	bool "OMAP3 LDP board"
	depends on ARCH_OMAP3 && ARCH_OMAP34XX

config MACH_OMAP_3430SDP
	bool "OMAP 3430 SDP board"
	depends on ARCH_OMAP3 && ARCH_OMAP34XX

config MACH_OMAP3EVM
	bool "OMAP 3530 EVM board"
	depends on ARCH_OMAP35XX

config MACH_OMAP3517EVM
	bool "OMAP 3517 EVM board"
	depends on ARCH_OMAP35XX

menu "OMAP3 EVM Power Modules"

choice
	prompt "Select Power Module"
	default OMAP3EVM_TWL4030

config OMAP3EVM_TWL4030
	bool "TWL4030/TPS65950 Power Module"
	depends on I2C=y && ARCH_OMAP3
	help
	  Say yes here if you are using the TWL4030/TPS65950 based power module
	  for the EVM boards.

config OMAP3EVM_TPS65023
	bool "TPS65023 Power Module"
	depends on I2C=y && ARCH_OMAP3
	select REGULATOR_TPS65023 if REGULATOR
	help
	  Say yes here if you are using the TPS65023 based PR801 power module 
	  for the EVM boards.

config OMAP3EVM_TPS65073
	bool "TPS65073 Power Module"
	depends on I2C=y && ARCH_OMAP3
	select REGULATOR_TPS65073 if REGULATOR
	help
	  Say yes here if you are using the TPS65073 based PR861 power module 
	  for the EVM boards.

endchoice
endmenu

config MACH_OMAP3_BEAGLE
	bool "OMAP3 BEAGLE board"
	depends on ARCH_OMAP3 && ARCH_OMAP34XX

config MACH_OVERO
	bool "Gumstix Overo board"
	depends on ARCH_OMAP3 && ARCH_OMAP34XX

config MACH_OMAP3_PANDORA
	bool "OMAP3 Pandora"
	depends on ARCH_OMAP3 && ARCH_OMAP34XX
```

## arch/arm/plat-omap/dss/Kconfig
```kconfig
config OMAP2_DSS
        tristate "OMAP2/3 Display Subsystem support (EXPERIMENTAL)"
        depends on ARCH_OMAP2 || ARCH_OMAP3
        help
          OMAP2/3 Display Subsystem support.

if OMAP2_DSS

config OMAP2_DSS_DEBUG_SUPPORT
        bool "Debug support"
	default n
	help
	  This enables debug messages. You need to enable printing
	  with 'debug' module parameter.

config OMAP2_DSS_RFBI
	bool "RFBI support"
        default n

config OMAP2_DSS_VENC
	bool "VENC support"
        default y

choice
	prompt OMAP2_VENC_OUT_TYPE
	depends on OMAP2_DSS_VENC
	default OMAP2_VENC_OUT_TYPE_SVIDEO

config OMAP2_VENC_OUT_TYPE_SVIDEO
	bool "Use S-Video output interface"
	help
	  Select this option if you want to choose TV out over S-Video

config OMAP2_VENC_OUT_TYPE_COMPOSITE
	bool "Use Composite output interface"
	help
	  Select this option if you want to choose TV out over Composite
endchoice

if ARCH_OMAP3

config OMAP2_DSS_SDI
	bool "SDI support"
        default n

config OMAP2_DSS_DSI
	bool "DSI support"
        default n

endif

config OMAP2_DSS_USE_DSI_PLL
	bool "Use DSI PLL for PCLK (EXPERIMENTAL)"
	default n
	depends on OMAP2_DSS_DSI
	help
	  Use DSI PLL to generate pixel clock.
	  Currently only for DPI output.

config OMAP2_DSS_FAKE_VSYNC
	bool "Fake VSYNC irq from manual update displays"
	default n
	help
	  If this is selected, DSI will fake a DISPC VSYNC interrupt
	  when DSI has sent a frame. This is only needed with DSI or
	  RFBI displays using manual mode, and you want VSYNC to time,
	  for example, animation.

config OMAP2_DSS_MIN_FCK_PER_PCK
	int "Minimum FCK/PCK ratio (for scaling)"
	range 0 32
	default 4
	help
	  This can be used to adjust the minimum FCK/PCK ratio.

	  With this you can make sure that DISPC FCK is at least
	  n x PCK. Video plane scaling requires higher FCK than
	  normally.

	  If this is set to 0, there's no extra constraint on the
	  DISPC FCK. However, the FCK will at minimum be
	  2xPCK (if active matrix) or 3xPCK (if passive matrix).

	  Max FCK is 173MHz, so this doesn't work if your PCK
	  is very high.

endif
```

## drivers/dsp/dspbridge/Kconfig
```kconfig
#
# DSP Bridge Driver Support
#

menuconfig MPU_BRIDGE
	tristate "DSP Bridge driver"
	default n
```

## drivers/media/video/isp/Kconfig
```kconfig
# Kconfig for OMAP3 ISP driver

config VIDEO_OMAP3_ISP
	tristate
	select VIDEOBUF_GEN
	select VIDEOBUF_DMA_SG

config VIDEO_OMAP34XX_ISP_PREVIEWER
	tristate "OMAP ISP Previewer"
	depends on !ARCH_OMAP3410
	select VIDEO_OMAP3_ISP

config VIDEO_OMAP34XX_ISP_RESIZER
	tristate "OMAP ISP Resizer"
	depends on !ARCH_OMAP3410
	select VIDEO_OMAP3_ISP
```

## drivers/media/video/omap/Kconfig
```kconfig
config VIDEO_OMAP_VIDEOLIB
	tristate "OMAP Video out library"
	depends on VIDEO_OMAP3
	default VIDEO_OMAP3

config VIDEO_OMAP_VIDEOOUT
	tristate "OMAP Video out driver"
	select VIDEOBUF_DMA_SG
	select VIDEOBUF_GEN
	depends on VIDEO_OMAP3
	default VIDEO_OMAP3

config VID1_OMAP_ON_TV
	bool "Default Overlay manager for Video1 pipeline will be TV"
	depends on VIDEO_OMAP_VIDEOOUT
	default n

config VID2_OMAP_ON_TV
	bool "Default Overlay manager for Video2 pipeline will be TV"
	depends on VIDEO_OMAP_VIDEOOUT
	default n
choice
        prompt "TV Mode"
        depends on VID1_OMAP_ON_TV || VID2_OMAP_ON_TV
        default NTSC_M

config NTSC_M
        bool "Use NTSC_M mode"
        help
          Select this option if you want NTSC_M mode on TV

config PAL_BDGHI
        bool "Use PAL_BDGHI mode"
        help
          Select this option if you want PAL_BDGHI mode on TV

endchoice
```

## drivers/media/video/tiler/Kconfig
```kconfig
config TILER_OMAP
	tristate "OMAP TILER support"
	default n
	help
		TILER driver for OMAP based boards.
```

## drivers/video/omap2/Kconfig
```kconfig
config FB_OMAP2
        tristate "OMAP2/3 frame buffer support (EXPERIMENTAL)"
        depends on FB && ARCH_OMAP

        select FB_CFB_FILLRECT
        select FB_CFB_COPYAREA
        select FB_CFB_IMAGEBLIT
	select FB_BACKLIGHT
	select OMAP2_DSS
        help
          Frame buffer driver for OMAP2/3 based boards.

config FB_OMAP2_DEBUG
	bool "Debug support for OMAP2/3 FB"
	default n
	depends on FB_OMAP2
	help
	  Support for debug output. You have to enable the actual printing
	  with debug module parameter.

config FB_OMAP2_FORCE_AUTO_UPDATE
	bool "Force main display to automatic update mode"
	depends on FB_OMAP2
	help
	  Forces main display to automatic update mode (if possible),
	  and also enables tearsync (if possible). By default
	  displays that support manual update are started in manual
	  update mode.

config FB_OMAP2_NUM_FBS
	int "Number of framebuffers"
	range 1 3
	default 1
	depends on FB_OMAP2
	help
	  Select the number of framebuffers created. OMAP2/3 has 3 overlays
	  so normally this would be 3.

menu "OMAP2/3 Display Device Drivers"
        depends on OMAP2_DSS

config PANEL_GENERIC
        tristate "Generic Panel"
	default y
        help
	  Generic panel driver.
	  Used for DVI output for Beagle and OMAP3 SDP.
choice
	prompt "Resolution"
	depends on PANEL_GENERIC
	default RES_480P

config RES_480P
	bool "Use 480P resolution"
	help
	  Select this option if you want to use the 480P (720x480)
	  resolution on DVI output.

config RES_720P
	bool "Use 720P resolution"
	help
	  Select this option if you want to use the 720P (1280x720)
	  resolution on DVI output.

endchoice

config PANEL_SHARP_LS037V7DW01
        tristate "Sharp LS037V7DW01 LCD Panel"
	default y
        help
          LCD Panel used in TI's SDP3430 and EVM boards

config PANEL_N800
        tristate "panel n800"
        help
          N800 LCD

config CTRL_BLIZZARD
        tristate "blizzard ctrl"
        help
          Blizzard Ctrl

endmenu
```

## drivers/video/ti816x/Kconfig
```kconfig
source "drivers/video/ti816x/vpss/Kconfig"
source "drivers/video/ti816x/ti816xfb/Kconfig"
```

## drivers/video/ti816x/ti816xfb/Kconfig
```kconfig
menuconfig FB_TI816X
	tristate "TI816X frame buffer support (EXPERIMENTAL)"
	depends on FB && ARCH_TI816X && TI816X_VPSS
	select FB_CFB_FILLRECT
	select FB_CFB_COPYAREA
	select FB_CFB_IMAGEBLIT
	help
          Frame buffer driver for TI816x based boards.

config FB_TI816X_DEBUG_SUPPORT
	bool "Debug support for TI816X FB"
	default y
	depends on FB_TI816X
	help
	  Support for debug output. You have to enable the actual printing
	  with debug module parameter.

config FB_TI816X_NUM_FBS
	int "Number of framebuffers"
	range 1 3
	default 3
	depends on FB_TI816X
	help
	  Select the number of FB node created. TI816X has 3 GRPX planes
	  so normally this would be 3.
```

## drivers/video/ti816x/vpss/Kconfig
```kconfig
menuconfig TI816X_VPSS
        tristate "TI816X Video Processing Subsystem (EXPERIMENTAL)"
        depends on ARCH_TI816X
        help
          TI816X Video Processing Subsystem

if TI816X_VPSS

config TI816X_VPSS_VRAM_SIZE
	int "VRAM size (MB)"
	range 0 128
	default 50
	help
	  The amount of SDRAM to reserve at boot time for video RAM use.
	  This VRAM will be used by ti816xfb and other drivers that need
	  large continuous RAM area for video use.

	  You can also set this with "vram=<bytes>" kernel argument, or
	  in the board file.

config TI816X_VPSS_DEBUG_SUPPORT
        bool "Debug support"
	default y
	help
	  This enables debug messages.

config TI816X_VPSS_SII9022A
      bool  "offchip hdmi(sii9022a)"
      default y
      help
         This enables VS board(sii9022a HDMI transmitter) on the DVO2 VENC.

config TI816X_VPSS_SHARED_BUFFER_BASE
	hex "share buffer base(hex)"
	range 0xA0000000 0xBFC00000
	default 0xBF000000
	help
	    The base of share buffer to reserved for IPC notify between
	    A8 and M3. This  buffer is used by the vpss to transfer information
	    between A8 and M3 by syslink notify. It is non-cacheable in both CPU.

config TI816X_VPSS_SHARED_BUFFER_SIE
	int "share buffer size(KB)"
	range 512 2048
	default 1024
	help
	    The amount of share buffer to reserved for IPC notify between
	    A8 and M3. This  buffer is used by the vpss to transfer information
	    between A8 and M3 by syslink notify. It is non-cacheable in both CPU.
endif
```

## drivers/video/ti81xx/ti81xxfb/Kconfig
```kconfig
menuconfig FB_TI81XX
	tristate "TI81XX frame buffer support (EXPERIMENTAL)"
	depends on FB && ARCH_TI816X && TI81XX_VPSS
	select FB_CFB_FILLRECT
	select FB_CFB_COPYAREA
	select FB_CFB_IMAGEBLIT
	help
          Frame buffer driver for TI81xx based boards.

config FB_TI81XX_DEBUG_SUPPORT
	bool "Debug support for TI81XX FB"
	default y
	depends on FB_TI81XX
	help
	  Support for debug output. You have to enable the actual printing
	  with debug module parameter.

config FB_TI81XX_NUM_FBS
	int "Number of framebuffers"
	range 1 3
	default 3
	depends on FB_TI81XX
	help
	  Select the number of FB node created. TI81XX has 3 GRPX planes
	  so normally this would be 3.
```

## drivers/video/ti81xx/vpss/Kconfig
```kconfig
menuconfig TI81XX_VPSS
        tristate "TI81XX Video Processing Subsystem (EXPERIMENTAL)"
        depends on ARCH_TI816X
        help
          TI81XX Video Processing Subsystem

if TI81XX_VPSS

config TI81XX_VPSS_VRAM_SIZE
	int "VRAM size (MB)"
	range 0 128
	default 50
	help
	  The amount of SDRAM to reserve at boot time for video RAM use.
	  This VRAM will be used by ti81xxfb and other drivers that need
	  large continuous RAM area for video use.

	  You can also set this with "vram=<bytes>" kernel argument, or
	  in the board file.

config TI81XX_VPSS_DEBUG_SUPPORT
        bool "Debug support"
	default y
	help
	  This enables debug messages.

config TI81XX_VPSS_SHARED_BUFFER_BASE
	hex "sharing buffer base(hex)"
	range 0x80000000 0xC0000000
	default 0x8DE00000
	help
	    The base of shareing buffer to be reserved for IPC notify between
	    A8 and M3. This buffer is used by the vpss to transfer information
	    between A8 and M3 via syslink notify.
	    Before changing this address, app should carefully check Ducati AMMU
	    configuration of Ducati to make sure that the address is in
	    non-cacheable space from Ducati M3 side.

config TI81XX_VPSS_SHARED_BUFFER_SIE
	int "sharing buffer size(KB)"
	range 512 2048
	default 1024
	help
	    The amount of shareing buffer to be reserved for IPC notify between
	    A8 and M3. This buffer is used by the vpss to transfer information
	    between A8 and M3 by syslink notify.
endif
```

## fs/simfs/Kconfig
```kconfig
config  SIMFS
	bool "Local filesystem support"
	help
	  Choose Y here if you want to access files residing on your PC
          drives. This is supported only on TI simulator M5.1
          release onwards.

	  If unsure, say Y.

	  Most people say Y here.

config  SIMFS_PHYSADDR
	hex
	default 0x40280000
	depends on SIMFS
```
